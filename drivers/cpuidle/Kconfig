## drivers/cpuidle/Kconfig
```kconfig
# SPDX-License-Identifier: GPL-2.0-only
menu "CPU Idle"

config CPU_IDLE
	bool "CPU idle PM support"
	default y if ACPI || PPC_PSERIES
	select CPU_IDLE_GOV_LADDER if (!NO_HZ && !NO_HZ_IDLE)
	select CPU_IDLE_GOV_MENU if (NO_HZ || NO_HZ_IDLE) && !CPU_IDLE_GOV_TEO && !CPU_IDLE_GOV_ADAPTIVE
	help
	  CPU idle is a generic framework for supporting software-controlled
	  idle processor power management.  It includes modular cross-platform
	  governors that can be swapped during runtime.

	  If you're using an ACPI-enabled platform, you should say Y here.

if CPU_IDLE

config CPU_IDLE_MULTIPLE_DRIVERS
	bool

config CPU_IDLE_GOV_LADDER
	bool "Ladder governor (for periodic timer tick)"

config CPU_IDLE_GOV_MENU
	bool "Menu governor (for tickless system)"

config CPU_IDLE_GOV_TEO
	bool "Timer events oriented (TEO) governor (for tickless systems)"
	help
	  This governor implements a simplified idle state selection method
	  focused on timer events and does not do any interactivity boosting.

	  Some workloads benefit from using it and it generally should be safe
	  to use.  Say Y here if you are not happy with the alternatives.

config CPU_IDLE_GOV_HALTPOLL
	bool "Haltpoll governor (for virtualized systems)"
	depends on KVM_GUEST
	help
	  This governor implements haltpoll idle state selection, to be
	  used in conjunction with the haltpoll cpuidle driver, allowing
	  for polling for a certain amount of time before entering idle
	  state.

	  Some virtualized workloads benefit from using it.

config CPU_IDLE_GOV_ADAPTIVE
	bool "Adaptive governor (for hybrid performance/power systems)"
	help
	  This governor implements an adaptive idle state selection method
	  that combines performance and power efficiency based on workload
	  detection and power source awareness.

	  It uses workload metrics (CPU load, IO wait, network activity) and
	  battery status to dynamically adjust C-state selection strategy,
	  providing low latency on AC power while maximizing power savings
	  on battery.

	  Some workloads benefit from using it and it is designed for laptops
	  and desktop systems. Say Y here if you want adaptive performance/power
	  balance.

choice
	prompt "Adaptive governor profile"
	depends on CPU_IDLE_GOV_ADAPTIVE
	default CPU_IDLE_GOV_ADAPTIVE_DESKTOP
	help
	  Profile for the adaptive governor's workload-multiplier formula.
	  This selects defaults that bias the governor for either consumer
	  workloads (low latency floor, light protection against deep states)
	  or latency-critical server workloads (higher latency floor, stronger
	  protection against deep C-states under network/IO load).

config CPU_IDLE_GOV_ADAPTIVE_DESKTOP
	bool "Desktop / laptop"
	help
	  Tuned for consumer workloads where the typical idle window is long
	  and brief responsiveness blips are acceptable in exchange for
	  better power savings. Sets BASE_MULTIPLIER=1 (Menu-TNG default)
	  and a moderate network factor of 10.

config CPU_IDLE_GOV_ADAPTIVE_SERVER
	bool "Server / latency-critical"
	help
	  Tuned for servers that care about tail latency under bursty
	  network or IO load (DPDK, RDMA, NVMe-oF, RPC tier). Raises
	  BASE_MULTIPLIER to 5 so even idle CPUs keep a small floor of
	  latency awareness, bumps the network factor to 30 so packet
	  bursts visibly inhibit deep states, and lifts the residency
	  correction-factor cap to 500ms so legitimate long idle windows
	  (overnight-idle hosts, long inter-RPC pauses) are not truncated
	  to 50ms. Pair with the SMT-sibling cap (always on) for
	  predictable wakeup latency on hyperthreaded CPUs.

endchoice

config DT_IDLE_STATES
	bool

config DT_IDLE_GENPD
	depends on PM_GENERIC_DOMAINS_OF
	bool

menu "ARM CPU Idle Drivers"
depends on ARM || ARM64
source "drivers/cpuidle/Kconfig.arm"
endmenu

menu "MIPS CPU Idle Drivers"
depends on MIPS
source "drivers/cpuidle/Kconfig.mips"
endmenu

menu "POWERPC CPU Idle Drivers"
depends on PPC
source "drivers/cpuidle/Kconfig.powerpc"
endmenu

menu "RISC-V CPU Idle Drivers"
depends on RISCV
source "drivers/cpuidle/Kconfig.riscv"
endmenu

config HALTPOLL_CPUIDLE
	tristate "Halt poll cpuidle driver"
	depends on X86 && KVM_GUEST
	select CPU_IDLE_GOV_HALTPOLL
	default y
	help
	 This option enables halt poll cpuidle driver, which allows to poll
	 before halting in the guest (more efficient than polling in the
	 host via halt_poll_ns for some scenarios).

endif # CPU_IDLE

config ARCH_NEEDS_CPU_IDLE_COUPLED
	def_bool n
endmenu
```
